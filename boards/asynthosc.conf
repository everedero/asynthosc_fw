## boards/asynthosc.conf
```kconfig
CONFIG_SSD1306_DEFAULT_CONTRAST=50
CONFIG_SSD1306=y
CONFIG_SPI_SHELL=y
CONFIG_GPIO=y
CONFIG_INPUT=y
CONFIG_INPUT_GPIO_QDEC=y
```

## boards/rederotech/asynthosc/Kconfig.asynthosc
```kconfig
# Copyright (c) 2020 Teslabs Engineering S.L.
# SPDX-License-Identifier: Apache-2.0

config BOARD_ASYNTHOSC
	select SOC_STM32H743XX
```

## lib/Kconfig
```kconfig
# Copyright (c) 2021 Legrand North America, LLC.
# SPDX-License-Identifier: Apache-2.0

menu "Tiny OSC library"

rsource "tinyosc/Kconfig"

endmenu
```

## lib/tinyosc/Kconfig
```kconfig
# Copyright (c) 2021, Legrand North America, LLC.
# SPDX-License-Identifier: Apache-2.0

config TINYOSC
	bool "Support for tinyosc library"
	help
	  This option enables the tinyosc library

config TINYOSC_BUNDLE_ID
	int "custom_get_value() default return value"
	depends on TINYOSC
	default 2549729456036799744 #0x2362756E646C6500
	help
          Bundle ID used to identify tinyosc messages.
          Default value is "#bundle"
```

## samples/adc_sequence/sample.yaml
```yaml
sample:
  name: ADC driver sequence sample
tests:
  sample.drivers.adc.adc_sequence:
    tags:
      - adc
    depends_on: adc
    platform_allow:
      - asynthosc
    integration_platforms:
      - asynthosc
    harness: console
    timeout: 10
    harness_config:
      type: multi_line
      regex:
        - "ADC sequence reading \\[\\d+\\]:"
        - "- .+, channel \\d+, \\d+ sequence samples:"
        - "- - \\d+ (= \\d+mV)|(\\(value in mV not available\\))"
```

## tests/lib/tinyosc/testcase.yaml
```yaml
common:
  tags: extensibility
  integration_platforms:
    - qemu_cortex_m0
    - asynthosc
tests:
  lib.tinyosc: {}
  lib.tinyosc.non_default:
    extra_args: CONFIG_TINYOSC_PRINTF=y
```
