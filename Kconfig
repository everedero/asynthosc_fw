## boards/rederotech/asynthosc/board.yml
```yaml
board:
  name: asynthosc
  full_name: RederoTech AsynthOsc
  vendor: rederotech
  socs:
    - name: stm32h743xx
```

## drivers/audio_dac/Kconfig
```kconfig
config DAC_AUDIO_STM32
	bool "STM32 DAC audio codec driver"
	depends on DT_HAS_ST_STM32_DAC_AUDIO_ENABLED
	select AUDIO_CODEC
	select DMA
	select PINCTRL
	help
	  Audio output driver implementing audio_codec_api using an STM32 DAC
	  with timer-triggered DMA waveform generation. Supports any sample rate
	  that is an exact integer divisor of the timer peripheral clock.
```

## dts/bindings/audio/st,stm32-dac-audio.yaml
```yaml
description: |
  STM32 DAC audio output implementing the Zephyr audio_codec_api.
  Uses a basic hardware timer (TIM6 or TIM7) to trigger DMA-driven DAC
  conversions at the configured sample rate.

  Two peripheral address ranges: [0] DAC base, [1] timer base.
  Two clock entries: DAC clock then timer clock (matching reg-names order).
  One DMA channel named "tx" for audio output.

compatible: "st,stm32-dac-audio"

include: [pinctrl-device.yaml]

properties:
  reg:
    required: true
    type: array
    description: |
      Two address ranges: index 0 = DAC peripheral base (0x40007400 for DAC1),
      index 1 = basic timer base (0x40001000 for TIM6).

  reg-names:
    required: true
    type: string-array
    description: '"dac" and "tim".'

  clocks:
    required: true
    type: phandle-array
    description: DAC clock then timer clock, in reg-names order.

  clock-names:
    required: true
    type: string-array
    description: '"dac" and "tim".'

  dmas:
    required: true
    type: phandle-array
    description: |
      Single TX DMA channel. DMAMUX request = DAC channel 1
      (LL_DMAMUX1_REQ_DAC1_CH1 = 67 on STM32H7).

  dma-names:
    required: true
    type: string-array
    description: '"tx"'

  pinctrl-0:
    required: true

  pinctrl-names:
    required: true
```

## west.yml
```yaml
# Copyright (c) 2021 Nordic Semiconductor ASA
# SPDX-License-Identifier: Apache-2.0

manifest:
  self:
    west-commands: scripts/west-commands.yml

  remotes:
    - name: zephyrproject-rtos
      url-base: https://github.com/zephyrproject-rtos
    - name: eve-fork
      url-base: https://github.com/everedero

  projects:
    - name: zephyr
      remote: eve-fork
      revision: feat/stm32-dac-audio
      import:
        # By using name-allowlist we can clone only the modules that are
        # strictly needed by the application.
        name-allowlist:
          - cmsis_6    # required by the ARM port
          - hal_nordic # required by the custom_plank board (Nordic based)
          - hal_stm32  # required by the nucleo_f302r8 board (STM32 based)
          - lvgl
```
